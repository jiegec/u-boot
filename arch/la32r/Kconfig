## arch/la32r/Kconfig
```kconfig
menu "LA32R architecture"
	depends on LA32R

config SYS_ARCH
	default "la32r"

choice
	prompt "soc select"
	default TARGET_LA32R_LOONGSONSOC_DEMO

config TARGET_LA32R_LOONGSONSOC_DEMO
	bool "LA32R SOC Demo Soc"

endchoice

config LA32R_L1_CACHE_SHIFT
	int
	default "4"

config SYS_ICACHE_LINE_SIZE
	int
	default "16"
	help
	  The size of L1 Icache lines, if known at compile time.

config SYS_DCACHE_LINE_SIZE
	int
	default "16"
	help
	  The size of L1 Dcache lines, if known at compile time.

menu "OS boot interface"

config LA32R_BOOT_FDT
	bool "Hand over a flattened device tree to Linux kernel"
	default y
	help
	  Enable this option if you want U-Boot to hand over a flattened
	  device tree to the kernel. According to UHI register $a0 will be set
	  to -2 and the FDT address is stored in $a1.
endmenu

config SYS_CONFIG_NAME
    string "Config name"
	default "la32rsoc_demo" if TARGET_LA32R_LOONGSONSOC_DEMO

config SYS_TEXT_BASE
    hex "Sys text base"
    default 0xa0200000

config LA32R_RELOCATION_TABLE_SIZE
	hex "Relocation table size"
	range 0x100 0x4000
	default "0x4000"
	---help---
	  A table of relocation data will be appended to the U-Boot binary
	  and parsed in relocate_code() to fix up all offsets in the relocated
	  U-Boot.

	  This option allows the amount of space reserved for the table to be
	  adjusted in a range from 256 up to 64k. The default is 32k and should
	  be ok in most cases. Reduce this value to shrink the size of U-Boot
	  binary.

	  The build will fail and a valid size suggested if this is too small.

	  If unsure, leave at the default value.

endmenu
```

## board/custom/rocket-chip-vcu128/Kconfig
```kconfig
if TARGET_ROCKET_CHIP_VCU128

config SYS_BOARD
	default "rocket-chip-vcu128"

config SYS_VENDOR
	default "custom"

config SYS_CPU
	default "generic"

config SYS_CONFIG_NAME
	default "rocket-chip-vcu128"

config TEXT_BASE
	default 0x80040000

config BOARD_SPECIFIC_OPTIONS # dummy
	def_bool y
	select GENERIC_RISCV
	imply SMP
	imply BOARD_LATE_INIT
	imply SYS_NS16550

endif
```

## configs/rocket-chip-vcu128_defconfig
```kconfig
# below is copied from qemu defconfig
CONFIG_RISCV=y
CONFIG_SYS_MALLOC_LEN=0x800000
CONFIG_NR_DRAM_BANKS=1
CONFIG_HAS_CUSTOM_SYS_INIT_SP_ADDR=y
# override init stack address
# CONFIG_CUSTOM_SYS_INIT_SP_ADDR=0x80200000
CONFIG_CUSTOM_SYS_INIT_SP_ADDR=0x88000000
CONFIG_ENV_SIZE=0x20000
# CONFIG_DEFAULT_DEVICE_TREE="qemu-virt64"
# override default linux load addr
# CONFIG_SYS_LOAD_ADDR=0x80200000
CONFIG_SYS_LOAD_ADDR=0x80100000
# override target board
# CONFIG_TARGET_QEMU_VIRT=y
CONFIG_TARGET_ROCKET_CHIP_VCU128=y
CONFIG_ARCH_RV64I=y
CONFIG_RISCV_SMODE=y
CONFIG_FIT=y
# 64MB for image.itb
CONFIG_SYS_BOOTM_LEN=0x4000000
# disable defaults to reduce size
# CONFIG_DISTRO_DEFAULTS=y
CONFIG_DISTRO_DEFAULTS=n
# CONFIG_USE_PREBOOT=y
# CONFIG_PREBOOT="setenv fdt_addr ${fdtcontroladdr}; fdt addr ${fdtcontroladdr};"
CONFIG_DISPLAY_CPUINFO=y
CONFIG_DISPLAY_BOARDINFO=y
CONFIG_SYS_RELOC_GD_ENV_ADDR=y
CONFIG_DM_MTD=y
CONFIG_ENV_IS_NOWHERE=y
CONFIG_TIMESTAMP=y

# do not add reversed memory
# it is already handled in Linux
CONFIG_OF_BOARD_FIXUP=n

# reduce image size
CONFIG_BLK=n
CONFIG_MTD=n
CONFIG_REGEX=n
CONFIG_EFI_LOADER=n
CONFIG_PARTITIONS=n
CONFIG_CMD_NFS=n
CONFIG_CMD_CRC32=n
CONFIG_CMD_LZMADEC=n
CONFIG_CMD_UNLZ4=n
CONFIG_CMD_UNZIP=n
CONFIG_FIT_FULL_CHECK=n
CONFIG_FIT_ENABLE_SHA256_SUPPORT=n
CONFIG_GZIP=n
CONFIG_SHA256=n
CONFIG_DM_MMC=n
CONFIG_CMD_LOADB=n
CONFIG_CMD_FDT=n
CONFIG_CRC32=n
CONFIG_BOOTMETH_DISTRO=n
CONFIG_PXE_UTILS=n
CONFIG_BOOTMETH_VBE=n

# as payload of opensbi
# align with FW_PAYLOAD_OFFSET=0x40000
CONFIG_TEXT_BASE=0x80040000

# early debug uart
CONFIG_DEBUG_UART=y
CONFIG_DEBUG_UART_NS16550=y
CONFIG_DEBUG_UART_CLOCK=100000000
CONFIG_DEBUG_UART_BASE=0x60201000
CONFIG_DEBUG_UART_SHIFT=2
CONFIG_BAUDRATE=115200

# axi quad spi driver
CONFIG_SPI=y
CONFIG_SPI_FLASH=y
CONFIG_XILINX_SPI=y
CONFIG_CMD_SPI=y
CONFIG_SPI_FLASH_STMICRO=y

# axi ethernet driver
CONFIG_DM_ETH=y
CONFIG_DM_MDIO=y
CONFIG_DM_ETH_PHY=y
CONFIG_PHY=y
CONFIG_NET=y
CONFIG_XILINX_AXIEMAC=y
CONFIG_CMD_MII=n
CONFIG_CMD_MDIO=n
CONFIG_CMD_BOOTP=n
CONFIG_CMD_PING=y
CONFIG_PHY_TI_DP83867=y
CONFIG_PHY_XILINX=y

# axi i2c driver
CONFIG_DM_I2C=n
CONFIG_SYS_I2C_XILINX_XIIC=n
CONFIG_CMD_I2C=n

# tca6416a gpio driver
CONFIG_DM_GPIO=n
CONFIG_DM_PCA953X=n
CONFIG_CMD_GPIO=n

# use dtb from OpenSBI
CONFIG_OF_BOARD=y
CONFIG_DEFAULT_DEVICE_TREE="rocket-chip-vcu128-single-core"

# print boot timings
CONFIG_BOOTSTAGE=y
CONFIG_BOOTSTAGE_REPORT=y
CONFIG_BOOTSTAGE_RECORD_COUNT=100
```
